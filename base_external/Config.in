## base_external/Config.in
```kconfig
source "$BR2_EXTERNAL_assignment_base_PATH/package/aesd-assignments/Config.in"
source "$BR2_EXTERNAL_assignment_base_PATH/package/tmp_sensor/Config.in"
source "$BR2_EXTERNAL_assignment_base_PATH/package/gpiotest/Config.in"
source "$BR2_EXTERNAL_assignment_base_PATH/package/combined/Config.in"
```

## base_external/configs/aesd_rpi_defconfig
```kconfig
BR2_aarch64=y
BR2_ARM_FPU_VFPV4=y
BR2_TOOLCHAIN_BUILDROOT_GLIBC=y
BR2_TOOLCHAIN_BUILDROOT_CXX=y
BR2_ROOTFS_DEVICE_CREATION_DYNAMIC_MDEV=y
BR2_TARGET_GENERIC_ROOT_PASSWD="root"
BR2_SYSTEM_DHCP="eth0"
BR2_ROOTFS_OVERLAY="../base_external/rootfs_overlay"
BR2_ROOTFS_POST_BUILD_SCRIPT="board/raspberrypi3-64/post-build.sh"
BR2_ROOTFS_POST_IMAGE_SCRIPT="board/raspberrypi3-64/post-image.sh ../base_external/post-image.sh"
BR2_ROOTFS_POST_SCRIPT_ARGS="--aarch64 --add-miniuart-bt-overlay --add-I2C"
BR2_LINUX_KERNEL=y
BR2_LINUX_KERNEL_CUSTOM_TARBALL=y
BR2_LINUX_KERNEL_CUSTOM_TARBALL_LOCATION="$(call github,raspberrypi,linux,967d45b29ca2902f031b867809d72e3b3d623e7a)/linux-967d45b29ca2902f031b867809d72e3b3d623e7a.tar.gz"
BR2_LINUX_KERNEL_DEFCONFIG="bcmrpi3"
BR2_LINUX_KERNEL_DTS_SUPPORT=y
BR2_LINUX_KERNEL_INTREE_DTS_NAME="broadcom/bcm2710-rpi-3-b broadcom/bcm2710-rpi-3-b-plus broadcom/bcm2837-rpi-3-b"
BR2_LINUX_KERNEL_NEEDS_HOST_OPENSSL=y
BR2_PACKAGE_BUSYBOX_SHOW_OTHERS=y
BR2_PACKAGE_RPI_FIRMWARE=y
BR2_PACKAGE_RPI_WIFI_FIRMWARE=y
BR2_PACKAGE_I2C_TOOLS=y
BR2_PACKAGE_PIGPIO=y
BR2_PACKAGE_RASPI_GPIO=y
BR2_PACKAGE_LIBGPIOD=y
BR2_PACKAGE_LIBGPIOD_TOOLS=y
BR2_PACKAGE_APACHE=y
BR2_PACKAGE_DROPBEAR=y
BR2_PACKAGE_IW=y
BR2_PACKAGE_WIRELESS_TOOLS=y
BR2_PACKAGE_WPA_SUPPLICANT=y
BR2_PACKAGE_WPA_SUPPLICANT_PASSPHRASE=y
BR2_PACKAGE_NANO=y
BR2_PACKAGE_VIM=y
BR2_TARGET_ROOTFS_EXT2=y
BR2_TARGET_ROOTFS_EXT2_4=y
BR2_TARGET_ROOTFS_EXT2_SIZE="120M"
# BR2_TARGET_ROOTFS_TAR is not set
BR2_PACKAGE_HOST_DOSFSTOOLS=y
BR2_PACKAGE_HOST_GENIMAGE=y
BR2_PACKAGE_HOST_MTOOLS=y
BR2_PACKAGE_AESD_ASSIGNMENTS=y
BR2_PACKAGE_TMP_SENSOR=y
BR2_PACKAGE_GPIOTEST=y
BR2_PACKAGE_COMBINED=y
```

## base_external/package/combined/Config.in
```kconfig
config BR2_PACKAGE_COMBINED
        bool "combined"
        help
          Includes the files required to get data from  TMP102-I2C based sensor and controlling GPIO LED based on the data
```

## base_external/package/gpiotest/Config.in
```kconfig
config BR2_PACKAGE_GPIOTEST
	bool "gpiotest"
	help
	  Includes the gpiotest script to test the gpio functionality
```

## base_external/package/tmp_sensor/Config.in
```kconfig
config BR2_PACKAGE_TMP_SENSOR
	bool "tmp_sensor"
	help
	  Includes the files required to get data from  TMP102-I2C based sensor
```
